## build/Kconfig/Kconfig.shield
```kconfig
osource "c:/lwm2m_client/boards/shields/*/Kconfig.shield"
osource "C:/ncs/v2.0.0/nrf/boards/shields/*/Kconfig.shield"
```

## build/Kconfig/Kconfig.shield.defconfig
```kconfig
osource "c:/lwm2m_client/boards/shields/*/Kconfig.defconfig"
osource "C:/ncs/v2.0.0/nrf/boards/shields/*/Kconfig.defconfig"
```
